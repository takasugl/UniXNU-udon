## configs/udon_defconfig
```kconfig
# Minimal OnePlus Ace 2 (udon/PHK110) kernel configuration for first XNU boot.
CONFIG_XNU_SOURCE_CORECRYPTO14=y
CONFIG_XNU_SOURCE_PTHREAD=y
CONFIG_XNU_ARM_DT_PLATFORM=y
CONFIG_XNU_ARMCPU=y
CONFIG_XNU_NATIVE_UFS=y
CONFIG_XNU_NATIVE_AES=y
CONFIG_XNU_NATIVE_RAM_BLOCK=y
CONFIG_XNU_TRUST_CACHE_RUNTIME=y
CONFIG_XNU_OWNER_CACHE_MOUNT=y
CONFIG_XNU_OWNER_CACHE_STARTUP=y
CONFIG_XNU_OWNER_CACHE_CARRIER=y
CONFIG_XNU_OWNER_BOOT_MANIFEST=y
CONFIG_XNU_OWNER_DATA_MOUNT=y
CONFIG_XNU_OWNER_UNION_SYSTEMOS=n
CONFIG_XNU_SOURCE_MOCKFS=n
CONFIG_XNU_NATIVE_CS_HASH_CACHE=y
CONFIG_XNU_DT_PANIC_REGION=y
CONFIG_XNU_ZONE_PGZ_ALIGNMENT_PROBE=y
CONFIG_XNU_SHENG_PMGR=y
CONFIG_XNU_NATIVE_ARCH_TIMER=y
CONFIG_XNU_NATIVE_PAN=y
CONFIG_XNU_BOOT_PROGRESS=y

CONFIG_XNU_CRYPTO_BOOTSTRAP="prelinked"
CONFIG_XNU_OWNER_DATA_VOLUME_UUID="2CEE995C-91D2-45E8-9143-A2BF437F2453"
CONFIG_XNU_EXTRA_LD_ARCHIVES="{tree}/build/udon-probe-stubs/libProbeStubs.a {tree}/build/udon-ufs-bindings/libUfsBindings.a"
CONFIG_XNU_NATIVE_MOBILE_DISPLAY=n
CONFIG_XNU_ARMVIRT_PLATFORM=n
CONFIG_XNU_NATIVE_LEGACY_DISPLAY=n
```
